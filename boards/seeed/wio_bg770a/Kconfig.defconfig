## boards/seeed/wio_bg770a/Kconfig.defconfig
```kconfig
# Wio BG770A board configuration

# Copyright (c) Seeed K.K.
# SPDX-License-Identifier: Apache-2.0

if BOARD_WIO_BG770A

source "boards/common/usb/Kconfig.cdc_acm_serial.defconfig"

endif # BOARD_WIO_BG770A
```

## boards/seeed/wio_bg770a/Kconfig.wio_bg770a
```kconfig
# Copyright (c) Seeed K.K.
# SPDX-License-Identifier: Apache-2.0

config BOARD_WIO_BG770A
	select SOC_NRF52840_QIAA
```

## boards/seeed/wio_bg770a/board.yml
```yaml
# Copyright (c) Seeed K.K.
# SPDX-License-Identifier: Apache-2.0

board:
  name: wio_bg770a
  full_name: Wio BG770A
  vendor: seeed
  socs:
  - name: nrf52840
```
