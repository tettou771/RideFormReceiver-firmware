/*
	SlimeVR Code is placed under the MIT license
	Copyright (c) 2025 SlimeVR Contributors

	Permission is hereby granted, free of charge, to any person obtaining a copy
	of this software and associated documentation files (the "Software"), to deal
	in the Software without restriction, including without limitation the rights
	to use, copy, modify, merge, publish, distribute, sublicense, and/or sell
	copies of the Software, and to permit persons to whom the Software is
	furnished to do so, subject to the following conditions:

	The above copyright notice and this permission notice shall be included in
	all copies or substantial portions of the Software.

	THE SOFTWARE IS PROVIDED "AS IS", WITHOUT WARRANTY OF ANY KIND, EXPRESS OR
	IMPLIED, INCLUDING BUT NOT LIMITED TO THE WARRANTIES OF MERCHANTABILITY,
	FITNESS FOR A PARTICULAR PURPOSE AND NONINFRINGEMENT. IN NO EVENT SHALL THE
	AUTHORS OR COPYRIGHT HOLDERS BE LIABLE FOR ANY CLAIM, DAMAGES OR OTHER
	LIABILITY, WHETHER IN AN ACTION OF CONTRACT, TORT OR OTHERWISE, ARISING FROM,
	OUT OF OR IN CONNECTION WITH THE SOFTWARE OR THE USE OR OTHER DEALINGS IN
	THE SOFTWARE.
*/
#include "globals.h"
#include "esb.h"
#include "tdma.h"

uint16_t led_clock = 0;

// RFT: provided by esb.c — sync_thread gates on these.
extern bool esb_initialized;
extern bool esb_paired;

LOG_MODULE_REGISTER(timer, 4);

// RFT: TDMA-aware sync thread. Two ACK kinds share the same ESB ACK FIFO:
//
//   - TIMING ACK (byte[0] = 0xFB)   — carries us_until_next_cycle, cycle
//                                     counter, stride. Trackers use it to
//                                     anchor their slot timing. Refreshed
//                                     at 1 kHz so the value the tracker
//                                     reads is at most ~1 ms stale.
//   - CMD ACK    (byte[0] = flags)  — carries global flags + targeted
//                                     cmd (SET_MAG_BIAS, SET_SLOT_INDEX,
//                                     SET_MAX_RATE_HZ, etc.). Existing
//                                     led-clock-anchored format.
//
// Each tick we ask tdma_should_send_cmd_ack(): if there is a queued cmd or
// the periodic flag-refresh tick has come around, send a CMD ACK; otherwise
// send TIMING. Trackers branch on data[0] to pick the right parser.
//
// Why the previous PRX↔PTX swap approach was broken:
//   ESB trackers run in PTX mode permanently. A PTX-mode device can only
//   receive *ACK payloads* — replies to its own TX, generated by the PRX
//   peer. Unsolicited PTX broadcasts from a peer in PTX are not received.
//   See firmware-receiver/src/connection/esb.c esb_initialize() comment.
static void tdma_sync_thread(void)
{
	// Wait for the system to stabilise (USB CDC, ESB pairing) before we
	// start poking the radio.
	k_msleep(2000);
	tdma_init();
	while (1) {
		// 1 kHz refresh keeps the FIFO populated with a fresh TIMING ACK.
		// CONFIG_ESB_TX_FIFO_SIZE = 1 → most writes return -ENOMEM
		// (FIFO already holds the last one). That's the goal — whoever
		// TXes next consumes the newest entry, so timing is ≤ 1 ms stale.
		k_msleep(1);
		if (!esb_initialized || !esb_paired) continue;

		if (tdma_should_send_cmd_ack()) {
			esb_write_sync(led_clock);
			led_clock++;
			led_clock %= 17 * 600 / 3;
		} else {
			esb_write_tdma_timing();
		}
	}
}
K_THREAD_DEFINE(tdma_sync_thread_id, 1024, tdma_sync_thread, NULL, NULL, NULL, 5, 0, 0);

// Kept as a no-op so esb_thread's call site doesn't need conditional code.
void timer_init(void) { }
